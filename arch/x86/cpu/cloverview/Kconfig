## arch/x86/cpu/cloverview/Kconfig
```kconfig
# SPDX-License-Identifier: GPL-2.0+

config INTEL_CLOVERVIEW
	bool
	depends on INTEL_MID
	imply INTEL_MID_SERIAL
	imply MMC
	imply MMC_SDHCI
	imply MMC_SDHCI_SDMA
	imply MMC_SDHCI_TANGIER
	imply MISC

if INTEL_CLOVERVIEW

config SYS_CAR_ADDR
	hex
	default 0x19200000

config SYS_CAR_SIZE
	hex
	default 0x4000
	help
	  Space in bytes in eSRAM used as Cache-As-RAM (CAR).
	  Note this size must not exceed eSRAM's total size.

endif
```

## board/acer/ducati/Kconfig
```kconfig
if VENDOR_ACER

choice
	prompt "Mainboard model"

config TARGET_DUCATI
	bool "Acer Iconia A1-830"

endchoice

config SYS_BOARD
	default "ducati"

config SYS_VENDOR
	default "acer"

config SYS_SOC
	default "cloverview"

config SYS_MALLOC_LEN
	default 0x02000000

config TEXT_BASE
	default 0x01101000

config BOARD_SPECIFIC_OPTIONS # dummy
	def_bool y
	select X86_LOAD_FROM_32_BIT
	select INTEL_MID
	select INTEL_CLOVERVIEW
	select BOARD_LATE_INIT

endif
```

## configs/ducati_defconfig
```kconfig
CONFIG_X86=y
CONFIG_NR_DRAM_BANKS=8
CONFIG_DEFAULT_DEVICE_TREE="ducati"
CONFIG_VENDOR_ACER=y
CONFIG_TARGET_DUCATI=y
CONFIG_DEBUG_UART=y
CONFIG_BOOTDELAY=-2
CONFIG_HUSH_PARSER=y
CONFIG_CMD_CPU=y
CONFIG_CMD_MEMTEST=y
CONFIG_CMD_TIMER=y
CONFIG_CMD_GPT=y
CONFIG_CMD_MMC=y
CONFIG_CMD_PART=y
CONFIG_CMD_LSBLK=y
CONFIG_CMD_WDT=y
# CONFIG_CMD_SCSI is not set
# CONFIG_NET is not set
CONFIG_NO_NET=y
CONFIG_CPU=y
# CONFIG_PCI_PNP is not set
# CONFIG_DEBUG_UART is not set
CONFIG_X86_TSC_READ_BASE=y
CONFIG_WDT=y
CONFIG_WDT_TANGIER=y
# CONFIG_WATCHDOG_AUTOSTART is not set
CONFIG_CONSOLE_MUX=y
CONFIG_SYS_CONSOLE_IS_IN_ENV=y
CONFIG_SMP=y
CONFIG_MP=y
# CONFIG_I8259_PIC is not set
CONFIG_PRE_CONSOLE_BUFFER=y
CONFIG_PRE_CON_BUF_SZ=16384
CONFIG_PRE_CON_BUF_ADDR=0x100000
CONFIG_USB=y
CONFIG_USB_GADGET=y
CONFIG_USB_GADGET_MANUFACTURER="Acer"
CONFIG_USB_GADGET_VENDOR_NUM=0x0525
CONFIG_USB_GADGET_PRODUCT_NUM=0xa4a7
CONFIG_DM_USB_GADGET=y
CONFIG_USB_GADGET_LANGWELL=y
CONFIG_USB_GADGET_DOWNLOAD=y
CONFIG_USB_FUNCTION_ACM=y
CONFIG_USB_ACM_CONNECT_TIMEOUT=5000
CONFIG_VIDEO=y
CONFIG_VIDEO_SIMPLE=y
CONFIG_VIDEO_DT_SIMPLEFB=y
CONFIG_SEABIOS=y
CONFIG_SERIAL=y
# CONFIG_REQUIRE_SERIAL_CONSOLE is not set
CONFIG_GENERATE_ACPI_TABLE=y
CONFIG_CMD_FS_GENERIC=y
CONFIG_FS_FAT=y
CONFIG_CMD_FAT=y
CONFIG_FS_EXT4=y
CONFIG_CMD_EXT4=y
CONFIG_EFI_LOADER=y
CONFIG_EFI_VAR_BUF_SIZE=4096
CONFIG_STACK_SIZE=0x800000
```
